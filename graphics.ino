///  This whole program is for the adafruit ILI9341 display.
//  It was originally desinged for a display that would not have additional vram, 
// (the only difference being that the arduino can now display color, and only updates
//  changed characters)
//  so now it can be easily converted back into a monochrome 320 x 240 character
//  based display. 
//  
//  HOW IT WORKS:
//  the arduino stores a 30x40 byte array which represent the characters on display.
//  when it recieves "m" it assumes the rest of the input is 3 digits for x pos,
//  3 digits for y pos, and 3 digits for the character. (all in base ten)
//  in addition, the arduino stores an array called "color". the first value
//  corresponds to the color black, while the second value corresponds to white.
//  by inputing "c 2016" you can change the color of white. 
//  doing this before an update would change all newly displayed characters to green
//  but doing it while the arduino continues to draw allows an effect similar
//  to a horizontal interupt. 
//
//  the "u" command tells the arduino to update all chars next frame.
//
//  the "s" command instructs the arduino to display all the characters
//  indicated by the "updates" array. 

#include "SPI.h"
#include "Adafruit_GFX.h"
#include "Adafruit_ILI9341.h"

#define TFT_DC 9
#define TFT_CS 10


Adafruit_ILI9341 gfx = Adafruit_ILI9341(TFT_CS, TFT_DC);



byte tilemap[30][40];

char input[5];
int iter = 0;
byte updates[20][2];




const byte PROGMEM font[][8] =
{
  {0x00, 0x00, 0x00, 0x00, 0x00, 0x00, 0x00, 0x00}, // Char 000 (.)
  {0x1C, 0x22, 0x41, 0x7F, 0x41, 0x41, 0x41, 0x00}, // Char 001 (.)
  {0x7E, 0x21, 0x2E, 0x21, 0x21, 0x21, 0x7E, 0x00}, // Char 002 (.)
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  {0x37, 0x54, 0x16, 0x11, 0x16, 0x10, 0x7C, 0x00}, // Char 127 (.)
  
};





const byte  PROGMEM charset2[][8] = {
  {0x00,0x00,0x00,0x00,0x00,0x00,0x00,0x00},
  {0x08,0x08,0x08,0x08,0x08,0x08,0x08,0x08},
  {0x00,0x00,0x00,0x00,0xFF,0x00,0x00,0x00},
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  {0x00,0x00,0x00,0x00,0x08,0x08,0x08,0x08},

  };

const byte  PROGMEM charset3[][8] = {
  { 0x00, 0x00, 0x00, 0x00, 0x00, 0x00, 0x00, 0x00},
  { 0x3E, 0x63, 0x73, 0x7B, 0x6F, 0x67, 0x3E, 0x00},   // U+0010 (0)
  { 0xFE, 0x01, 0x01, 0xFE, 0x01, 0x01, 0x02, 0xfc},   // weird thing
  { 0x3c, 0x42, 0x81, 0x81, 0x81, 0x81, 0x42, 0x3c},   // Circle
  { 0x1E, 0x33, 0x30, 0x1C, 0x30, 0x33, 0x1E, 0x00},   // U+0013 (3)
  { 0x18, 0x3C, 0x66, 0xc3, 0xc3, 0x66, 0x3c, 0x18},   // diamond
  { 0x99, 0x66, 0x99, 0x66, 0x99, 0x66, 0x99, 0x66},   // low rez checkeboard
  { 0xAA, 0x55, 0xAA, 0x55, 0xAA, 0x55, 0xAA, 0x55},   // highrez cjecekerboard
  { 0xFF, 0xAA, 0xFF, 0xAA, 0xFF, 0xAA, 0xFF, 0xAA},   // 3/4 pattern
  { 0xCC, 0x99, 0x33, 0x66, 0x33, 0xCC, 0x99, 0x33},   // slashes
  { 0x1E, 0x33, 0x33, 0x3E, 0x30, 0x18, 0x0E, 0x00},   // U+0019 (9)
  { 0x00, 0x00, 0x00, 0x00, 0x18, 0x3c, 0x3c, 0x18},   // lower half dot
  { 0x0f, 0x0f, 0x0f, 0x0f, 0x00, 0x00, 0x00, 0x00},   // top right square
  { 0x00, 0x00, 0x00, 0x00, 0x0f, 0x0f, 0x0f, 0x0f},   // bottom right square
  { 0x00, 0x00, 0x00, 0x00, 0xf0, 0xf0, 0xf0, 0xf0},   // bottom left square
  { 0xf0, 0xf0, 0xf0, 0xf0, 0x00, 0x00, 0x00, 0x00}    // top left square
};

const byte  PROGMEM charset4[][8] = { // boxes
  { 0x00, 0x00, 0x00, 0x00, 0x00, 0x00, 0x00, 0x00},
  { 0x00, 0x00, 0x00, 0x00, 0x00, 0x00, 0x00, 0xFF},   // U+2581 (box 1/8)
  { 0x00, 0x00, 0x00, 0x00, 0x00, 0x00, 0xFF, 0xFF},   // U+2582 (box 2/8)
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  { 0x01, 0x01, 0x01, 0x01, 0x01, 0x01, 0x01, 0x01}   // U+258F (box 1/8)  
};



const byte PROGMEM xor_font[][8] =
{
  {0xC0, 0xC0, 0xC0, 0xC0, 0xC0, 0xC0, 0xC0, 0xC0}, // Char 000 (.)
  {0x00, 0x00, 0x00, 0x00, 0x00, 0x00, 0xFF, 0xFF}, // Char 001 (.)
  {0x03, 0x03, 0x03, 0x03, 0x03, 0x03, 0x03, 0x03}, // Char 002 (.)
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  {0x00, 0xFF, 0x00, 0xFF, 0x00, 0xFF, 0x00, 0xFF}, // Char 031 (.)
  
};


int out_color=0xFFFF;








bool screenupdate = false;
//byte colors[30][5];

byte graphics_mode=1;
int cursorpos=0;
bool Serial_active;

byte scale=1;
byte cull=1;

void setup() {
  pinMode(7, OUTPUT);
  gfx.begin();
  pinMode(2,INPUT);
  Serial.setTimeout(3);
  //gfx.select_font(font);
  // put your setup code here, to run once:
  gfx.fillScreen(0x0000);
  //pinMode(14,OUTPUT);



    Serial.println('D');
    memset(input, 0, sizeof(input));
    Serial.println('S');
    for(int i=0;i<1;i++){
    Serial.println('e');
    }

    delay(100);
    for(int i=0;i<1;i++){
    Serial.println('U');
    }

   

}

void loop() {

  digitalWrite(7,digitalRead(2));

  if(digitalRead(2)==HIGH){
    Serial.begin(115200);
    Serial.readBytes(input,5);
    Serial_active=true;
  }
  else{
    if(Serial_active==true){
      Serial.end();
      Serial_active=false;
    }
  }
  if(input[0]!=0){
   //Serial.println(input);
  }
  
  if (screenupdate) {
  //digitalWrite(7, HIGH);

   for (byte y = 0; y < 40; y++) {
        for (byte x = 0; x < 30; x++) {

          if (bitRead(updates[byte(y/2)][byte(x / 16)], byte(x/2) % 8)) {
          
            byte tile = tilemap[x][y];
            
            
              for (byte y2=0;y2<8;y2++){
                for (byte x2=0;x2<8;x2++){
                  byte pix1;
                  byte pix2;
                  byte out1;
                  byte out2;
                  switch(graphics_mode){
                  case 1:
                    pix1 = pgm_read_byte_near(&font[tile][y2]);
                    
                    out1 = bitRead(pix1, 7-x2 );
                    if (out1){out_color=0xFFFF;}
                    else{out_color=0x0000;}

                  break;

                  
                  case 2:
                    pix1 = pgm_read_byte_near(&font[tile/16][y2]);
                    out1 = bitRead(pix1, 7-x2 );
                    
                    pix2 = pgm_read_byte_near(&font[tile%16][y2]);
                    out2 = bitRead(pix2, 7-x2 );
                    if (out1^out2){out_color=0xFFFF;}
                    else{out_color=0x0000;}

                  break;  
                  
                  case 3:
                    
                  
                   if((tile>>4)-(tile%16)>0){
                    
                      pix1 = pgm_read_byte_near(&charset2[(0+tile)/16][y2]);
  
                      pix2 = pgm_read_byte_near(&charset2[(0+tile)%16][y2]);
                   }
                   else{
                     pix1 = pgm_read_byte_near(&charset3[(0+tile)/16][y2]);
  
                     pix2 = pgm_read_byte_near(&charset3[(0+tile)%16][y2]);}
                      
                    out1 = bitRead(pix1, x2 );
                    out2 = bitRead(pix2, x2 );
                    if (out1^out2){out_color=0xFFFF;}
                    else{out_color=0x0000;}
                    
                  break;
                  case 5:

                    out_color=0;
                    out_color=tile | tile<<8;
                    
                   
                  break;
                  case 6:


                    
                     pix1 = pgm_read_byte_near(&charset4[tile%16][y2]);
                     pix2 = pgm_read_byte_near(&charset4[tile/16][y2]);
                    
                    out1 = bitRead(pix1 | pix2, x2 );
                    if (out1){out_color=0xFFFF;}
                    else{out_color=0x0000;}
                    
                  break;
                  case 7:
                   
                   //Serial.print(tile>>4, HEX); Serial.print(" ");
                   //Serial.println(tile%16, HEX);
                   if((tile>>4)-(tile%16)>0 && tile>0){
                    
                      pix1 = pgm_read_byte_near(&xor_font[(0+tile)/16][y2]);
  
                     pix2 = pgm_read_byte_near(&xor_font[(0+tile)%16 ][y2]);
                   }
                   else if(tile>0){
                     
                     pix1 = pgm_read_byte_near(&xor_font[((0+tile)/16) + 16][y2]);
  
                     pix2 = pgm_read_byte_near(&xor_font[((0+tile)%16) + 16][y2]);} else{pix1=0; pix2 = 0; 
                   }
                      
                    out1 = bitRead(pix1, x2 );
                    out2 = bitRead(pix2, x2 );
                    if(tile/16 == tile%16){
                      if(out1){out_color=0xFFFF;} else {out_color=0x0000; } 
                    }
                    else if (  out1^out2 ){out_color=0xFFFF;}
                    else{out_color=0x0000;} 
                    
                  break;
                  }
                  gfx.fillRect( (x*8+x2)*scale, (y*8+y2)*scale,scale,scale, out_color);
                }  
              }
            }
        
          
        }
        //Serial.readBytes(input,15);
//        if (input[0]=='c') {
//          color[1][0]=input[1];
//          color[1][1]=input[2];
//          color[1][2]=input[3];
//          //Serial.println(colmor[1]);
//        }
        

    }
    //Serial.println('U');
    screenupdate = false;
    memset(updates, 0, sizeof(updates));
    //Serial.println('D');
    //digitalWrite(7,LOW);
  }

  

  //if (input[0]!=0){for(byte i=0; i<8;i++){Serial.println(String(byte(input[i])));}}
  if (input[0]==109){// Command: "mxyt"
      
      byte x = (input[1])%(byte)(30/cull);
      byte y = (input[2])%(byte)(40/cull);
      byte t = input[3];
      
      tilemap[x][y] = t;
      bitSet(updates[y/2][x/16], (x/2) % 8);
//      if(graphics_mode>=4){
//        bitSet(updates[y/2][((x+15)%30)/16 ], ((x+15)%30)/2 );
//        bitSet(updates[((y+20)%40)/2][((x)%30)/16 ], ((x)%30)/2 );
//        bitSet(updates[((y+20)%40)/2][((x+15)%30)/16 ], ((x+15)%30)/2 );              
//      }
      
      //Serial.println('S');
      //graphics_mode=(graphics_mode+1)%6;

      
  }
    if (input[0]=='g'){// Command: "gxy"
      byte x = (input[1])%(byte)(30/cull);
      byte y = (input[2])%(byte)(40/cull);
      Serial.print('T');
      Serial.print(tilemap[x][y]);

      
  }

  if (input[0]=='A'){// Command: "Ax"
      graphics_mode=input[1];     
  }
//  if (input[0]=='C'){// Command: "C" //toggle twice cull
//      cull++;    
//  }

  if (input[0]=='s'){
      screenupdate = true;
      //memset(updates, 255, sizeof(updates));
      //Serial.println('U');
      
   }
  memset(input, 0, sizeof(input));
  //digitalWrite(7, LOW);
}
